## config/boards/arm/skinner47/skinner47_left_defconfig
```kconfig
# SPDX-License-Identifier: MIT
CONFIG_ZMK_SLEEP=y
CONFIG_ZMK_IDLE_SLEEP_TIMEOUT=900000
CONFIG_INPUT=y
CONFIG_ZMK_MOUSE=y
CONFIG_ZMK_POINTING=y
CONFIG_PMW3610=y
CONFIG_PM_DEVICE=y
CONFIG_PMW3610_PM=y
CONFIG_PMW3610_CPI=400
CONFIG_PMW3610_CPI_DIVIDOR=1
CONFIG_PMW3610_ORIENTATION_180=y
CONFIG_PMW3610_SNIPE_CPI=800
CONFIG_PMW3610_SNIPE_CPI_DIVIDOR=4
CONFIG_PMW3610_SCROLL_TICK=32
CONFIG_PMW3610_INVERT_SCROLL_X=y
CONFIG_PMW3610_INVERT_SCROLL_Y=n
CONFIG_PMW3610_SMART_ALGORITHM=y
CONFIG_PMW3610_RUN_DOWNSHIFT_TIME_MS=3264
CONFIG_PMW3610_REST1_SAMPLE_TIME_MS=20
#CONFIG_PMW3610_REST1_DOWNSHIFT_TIME_MS=9600
#CONFIG_PMW3610_REST2_SAMPLE_TIME_MS=
#CONFIG_PMW3610_REST2_DOWNSHIFT_TIME_MS=
#CONFIG_PMW3610_REST3_SAMPLE_TIME_MS=
#CONFIG_PMW3610_REST3_DOWNSHIFT_TIME_MS=
#CONFIG_PMW3610_FORCE_AWAKE=n#CONFIG_PMW3610_FORCE_AWAKE=n
CONFIG_PMW3610_POLLING_RATE_125_SW=y
CONFIG_PMW3610_AUTOMOUSE_TIMEOUT_MS=700
CONFIG_PMW3610_MOVEMENT_THRESHOLD=0



CONFIG_ZMK_EXT_POWER=y
CONFIG_SOC_SERIES_NRF52X=y
CONFIG_SOC_NRF52840_QIAA=y
CONFIG_BOARD_SKINNER47_LEFT=y
CONFIG_ZMK_STUDIO=y
CONFIG_ZMK_STUDIO_LOCKING=n

CONFIG_LOG_PROCESS_THREAD_STARTUP_DELAY_MS=4000
CONFIG_ZMK_DISPLAY=y
CONFIG_SPI=y
# Enable MPU
CONFIG_ARM_MPU=y

CONFIG_PINCTRL=y

CONFIG_GPIO=y

CONFIG_USE_DT_CODE_PARTITION=y
CONFIG_BUILD_OUTPUT_UF2=y

CONFIG_MPU_ALLOW_FLASH_WRITE=y
CONFIG_NVS=y
CONFIG_SETTINGS_NVS=y
CONFIG_FLASH=y
CONFIG_FLASH_PAGE_LAYOUT=y
CONFIG_FLASH_MAP=y

CONFIG_ZMK_USB=y
CONFIG_ZMK_BLE=y
```

## config/boards/yangxing/keyball_neo47/board.yml
```yaml
boards:
  - name: keyball_neo47_left
    vendor: yangxing
    socs:
      - name: nrf52840
  - name: keyball_neo47_right
    vendor: yangxing
    socs:
      - name: nrf52840
```

## config/boards/yangxing/skinner47/board.yml
```yaml
boards:
  - name: skinner47_left
    vendor: yangxing
    socs:
      - name: nrf52840
  - name: skinner47_right
    vendor: yangxing
    socs:
      - name: nrf52840
```

## config/west.yml
```yaml
manifest:
  remotes:
    - name: zmk
      url-base: https://github.com/zmkfirmware
    - name: antoinegs
      url-base: https://github.com/AntoineGS
    - name: yangxing
      url-base: https://github.com/yangxing844
  projects:
    - name: zmk
      remote: zmk
      revision: v0.2
      import: app/west.yml
    - name: zmk-pmw3610-driver
      remote: antoinegs
      revision: main
    - name: zmk-lpm009m360a-driver
      remote: yangxing
      revision: master
  self:
    path: config
```
