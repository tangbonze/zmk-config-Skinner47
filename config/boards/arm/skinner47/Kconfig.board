## config/boards/arm/skinner47/Kconfig.board
```kconfig
# mikoto board configuration

# Copyright (c) 2020 The ZMK Contributors
# SPDX-License-Identifier: MIT

config BOARD_SKINNER47_LEFT
    bool "KeyBall keyboard left"
    depends on SOC_NRF52840_QIAA



config BOARD_SKINNER47_RIGHT
    bool "KeyBall keyboard right"
    depends on SOC_NRF52840_QIAA
```
